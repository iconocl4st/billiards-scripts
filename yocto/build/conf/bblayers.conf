## yocto/build/conf/bblayers.conf
```bitbake
# POKY_BBLAYERS_CONF_VERSION is increased each time build/conf/bblayers.conf
# changes incompatibly
POKY_BBLAYERS_CONF_VERSION = "2"

BBPATH = "${TOPDIR}"
BBFILES ?= ""
YOCTO_DIR='/yocto'

BBLAYERS ?= " \
  ${YOCTO_DIR}/sources/poky/meta \
  ${YOCTO_DIR}/sources/poky/meta-poky \
  ${YOCTO_DIR}/sources/poky/meta-yocto-bsp \
  ${YOCTO_DIR}/sources/meta-raspberrypi \
  ${YOCTO_DIR}/sources/meta-security \
  ${YOCTO_DIR}/sources/meta-openembedded/meta-oe \
  ${YOCTO_DIR}/sources/meta-openembedded/meta-multimedia \
  ${YOCTO_DIR}/sources/meta-openembedded/meta-networking \
  ${YOCTO_DIR}/sources/meta-openembedded/meta-python \
  ${YOCTO_DIR}/sources/meta-openembedded/meta-perl \
  ${YOCTO_DIR}/sources/meta-openembedded/meta-webserver \
  ${YOCTO_DIR}/sources/meta-qt5 \
  ${YOCTO_DIR}/sources/meta-rpi \
  ${YOCTO_DIR}/sources/meta-jumpnow \
  ${YOCTO_DIR}/sources/meta-billiards \
  "
```

## yocto/build/conf/local.conf
```bitbake
MACHINE = "raspberrypi3"
# MACHINE = "qemuarm"

YOCTO_DIR='/mnt/1f0ab4b3-c472-49e1-92d8-c0b5664f7fdb/ProjectsForFun/Pool/repos/billiards-scripts/yocto'


MACHINE_FEATURES_append = "wifi"
#IMAGE_INSTALL_append = " dhcp-server iptables wpa-supplicant"

DL_DIR = "${YOCTO_DIR}/output/dl_dir"
SSTATE_DIR = "${YOCTO_DIR}/output/sstate_dir"
TMPDIR = "${YOCTO_DIR}/output/tmp_dir"

LICENSE_FLAGS_WHITELIST = "commercial"
IMAGE_FSTYPES = "tar.xz"

DISTRO ?= "poky"
DISTRO_FEATURES = "ext2 opengl usbhost ${DISTRO_FEATURES_LIBC}"
DISTRO_FEATURES_remove = "X11 wayland"
DISTRO_FEATURES_BACKFILL_CONSIDERED += "pulseaudio"
DISABLE_VC4GRAPHICS = "1"
DISABLE_OVERSCAN = "1"
ENABLE_UART = "1"
ENABLE_RPI3_SERIAL_CONSOLE = "1"
SERIAL_CONSOLES = "115200;ttyAMA0"
PREFERRED_VERSION_linux-raspberrypi = "5.4.%"


PACKAGE_CLASSES ?= "package_rpm"
SDKMACHINE ?= "x86_64"

EXTRA_IMAGE_FEATURES ?= "debug-tweaks"
USER_CLASSES ?= "buildstats image-mklibs image-prelink"

BB_DISKMON_DIRS ??= "\
    STOPTASKS,${TMPDIR},1G,100K \
    STOPTASKS,${DL_DIR},1G,100K \
    STOPTASKS,${SSTATE_DIR},1G,100K \
    STOPTASKS,/tmp,100M,100K \
    ABORT,${TMPDIR},100M,1K \
    ABORT,${DL_DIR},100M,1K \
    ABORT,${SSTATE_DIR},100M,1K \
    ABORT,/tmp,10M,1K"

PACKAGECONFIG_append_pn-qemu-system-native = " sdl"
CONF_VERSION = "1"

INHERIT += "extrausers"
EXTRA_USERS_PARAMS = "usermod -P root root; "


USER_CLASSES = "image-mklibs image-prelink"
PATCHRESOLVE = "noop"
RM_OLD_IMAGE = "1"
INHERIT += "rm_work"
CONF_VERSION = "1"
```
